## meta-aic/conf/layer.conf
```bitbake
# We have a conf and classes directory, add to BBPATH
BBPATH .= ":${LAYERDIR}"

# We have recipes-* directories, add to BBFILES
BBFILES += "${LAYERDIR}/meta-common/recipes-*/*/*.bb \
            ${LAYERDIR}/meta-common/recipes-*/*/*.bbappend"

BBFILE_COLLECTIONS += "aic-layer"
BBFILE_PATTERN_aic-layer = "^${LAYERDIR}/"
LAYERSERIES_COMPAT_aic-layer = "langdale mickledore"

EXTRA_OEMESON:pn-bmcweb:append = "-Dbmcweb-logging='debug'"
```

## meta-aic/conf/machine/include/aic.inc
```bitbake
MACHINE_FEATURES += "\
        obmc-bmc-state-mgmt \
        obmc-chassis-state-mgmt \
        obmc-host-ipmi \
        obmc-host-state-mgmt \
        obmc-phosphor-chassis-mgmt \
        obmc-phosphor-fan-mgmt \
        obmc-phosphor-flash-mgmt \
        obmc-system-mgmt \
        obmc-fru-ipmi \
        obmc-devtools \
        obmc-sensors \
        "

OBMC_IMAGE_EXTRA_INSTALL:append = " \
                                   phosphor-gpio-monitor-monitor \
                                   phosphor-ipmi-blobs \
                                   phosphor-ipmi-blobs-binarystore \
                                   util-linux \
                                   phosphor-hwmon \
                                   peci-pcie \
                                   phosphor-hostlogger \
                                   phosphor-sel-logger \
                                   phosphor-post-code-manager \
                                   phosphor-host-postd \
                                   phosphor-led-manager \
                                   phosphor-ipmi-blobs \
                                   phosphor-snmp \
                                   phosphor-dbus-monitor \
                                   entity-manager \
                                   bmcweb \
                                   ipmitool \
                                   iotools \
                                   openocd \
                                   i2c-tools \
                                   smbios-mdr \
                                   biosconfig-manager \
                                   webui-vue \
                                  "

VIRTUAL-RUNTIME_obmc-inventory-manager = "entity-manager"
PREFERRED_PROVIDER_virtual/obmc-inventory-data = "entity-manager"
VIRTUAL-RUNTIME_obmc-sensors-hwmon = "phosphor-hwmon"

VIRTUAL-RUNTIME_obmc-host-state-manager ?= "x86-power-control"
VIRTUAL-RUNTIME_obmc-chassis-state-manager ?= "x86-power-control"

PREFERRED_PROVIDER_virtual/obmc-chassis-mgmt = "packagegroup-aic-apps"
PREFERRED_PROVIDER_virtual/obmc-flash-mgmt = "packagegroup-aic-apps"
PREFERRED_PROVIDER_virtual/obmc-host-ipmi-hw ?= "phosphor-ipmi-kcs"
PREFERRED_PROVIDER_virtual/obmc-system-mgmt = "packagegroup-aic-apps"
PREFERRED_PROVIDER_virtual/obmc-fan-mgmt = "packagegroup-aic-apps"
```

## meta-aic/meta-virgo/conf/layer.conf
```bitbake
# We have a conf and classes directory, add to BBPATH
BBPATH .= ":${LAYERDIR}"

# We have recipes-* directories, add to BBFILES
BBFILES += "${LAYERDIR}/recipes-*/*/*.bb \
            ${LAYERDIR}/recipes-*/*/*.bbappend"

BBFILE_COLLECTIONS += "virgo-layer"
BBFILE_PATTERN_virgo-layer = "^${LAYERDIR}/"
BBFILE_PRIORITY_virgo-layer = "5"
LAYERSERIES_COMPAT_virgo-layer = "langdale mickledore"
```

## meta-aic/meta-virgo/conf/machine/virgo.conf
```bitbake
KMACHINE = "aspeed"
KERNEL_DEVICETREE = "virgo.dtb"

PREFERRED_PROVIDER_virtual/bootloader = "u-boot-aspeed"
PREFERRED_PROVIDER_u-boot = "u-boot-aspeed"
PREFERRED_PROVIDER_u-boot-fw-utils = "u-boot-fw-utils-aspeed"
UBOOT_MACHINE = "ast_g5_phy_config"

require conf/machine/include/ast2500.inc
require conf/machine/include/obmc-bsp-common.inc
require conf/machine/include/aic.inc
require conf/distro/include/phosphor-aspeed-spi-master-mode.inc

FLASH_SIZE = "65536"

# We don't have configuration for these components yet, so remove them.
PREFERRED_PROVIDER_virtual/obmc-fan-mgmt = "aic-dummy"
IMAGE_FEATURES:remove = "obmc-fan-control"
IMAGE_FEATURES:remove = "obmc-fan-mgmt"
IMAGE_FEATURES:remove = "obmc-flash-mgmt"
```
